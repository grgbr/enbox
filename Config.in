## Config.in
```kconfig
config ENBOX_ASSERT
	bool "Assertion"
	default n
	help
	  Build enbox library with internal assertions.

config ENBOX_VERBOSE
	bool "Enable verbose logging"
	default n
	help
	  Build enbox library with internal verbose logging support. Will also
	  be usefull to prevent from false-positives when running under
	  Valgrind.

config ENBOX_DEBUG
	bool "Enable debug support"
	default n
	select ENBOX_ASSERT
	select ENBOX_VERBOSE
	help
	  Build enbox library with internal debugging instrumentation.

config ENBOX_INCLUDE_DIR
	string "Configuration include directory"
	default "/etc/enbox"
	help
	  Pathname to default configuration include directory.

config ENBOX_DISABLE_DUMP
	bool "Disable coredump generation"
	default y
	help
	  Disable generation of coredumps for current process. As side effect, it
	  can not be attached via ptrace(2) PTRACE_ATTACH either.
	  See sections about `/proc/sys/fs/suid_dumpable' and PR_SET_DUMPABLE
	  operation of proc(5) and prctl(2) man pages respectively.

config ENBOX_TOOL
	bool "Enable utility"
	default y
	help
	  Build enbox library tool.

config ENBOX_TOOL_LOG_SEVERITY
	int "Utility logger severity"
	range 0 7
	default 4
	depends on ENBOX_TOOL
	help
	  Internal tool messages with severity greater than this won't be sent
	  to logger(s).
	  See syslog(3) levels for more informations about available severities.

config ENBOX_TOOL_LOG_FACILITY
	int "Utility logger facility"
	range 0 23
	default 16
	depends on ENBOX_TOOL
	help
	  Enbox tool will log internal messages with this facility by default.
	  See syslog(3) facilities for more informations.

config ENBOX_TOOL_MQLOG_NAME
	string "Message queue name"
	default "/init"
	depends on ENBOX_TOOL
	help
	  Name of POSIX message queue that Enbox tool may use to log messages.
	  See mq_overview(7) for informations about message queue identifiers.

config ENBOX_TOOL_SHOW
	bool "Enable utility display"
	default n
	depends on ENBOX_TOOL
	help
	  Build enbox library tool with ability to display settings.

# ex: filetype=kconfig
```
